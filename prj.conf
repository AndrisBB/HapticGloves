## CMakeLists.txt
```
cmake_minimum_required(VERSION 3.20.0)

set(BOARD nrf52840dongle_nrf52840)

find_package(Zephyr)
project(nrf52_haptic)

target_sources(app PRIVATE src/main.c)
target_sources(app PRIVATE src/event_loop.c)
target_sources(app PRIVATE src/bt_service.c)
target_sources(app PRIVATE src/system_state.c)
```

## prj.conf
```kconfig
CONFIG_HEAP_MEM_POOL_SIZE=4096

CONFIG_SERIAL=y

CONFIG_LOG=y
CONFIG_LOG_MODE_IMMEDIATE=y

CONFIG_CONSOLE=y
CONFIG_STDOUT_CONSOLE=y
CONFIG_UART_CONSOLE=y
CONFIG_LOG_PRINTK=y

CONFIG_BT=y
CONFIG_BT_PERIPHERAL=y
CONFIG_BT_DEBUG_LOG=y
CONFIG_BT_DEVICE_NAME="Haptic glove"

CONFIG_PM=y
CONFIG_GPIO=y

CONFIG_SMF=y
```

## src/main.c
```c
#include <zephyr.h>
#include <init.h>
#include <device.h>
#include <devicetree.h>
#include <drivers/gpio.h>
#include <logging/log.h>

#include <hal/nrf_gpio.h>

#include "event_loop.h"
#include "bt_service.h"
#include "system_state.h"

LOG_MODULE_REGISTER(main);

#define SLEEP_TIME_MS			100
#define BUTTON_GPIO_PIN			DT_GPIO_PIN(DT_ALIAS(sw1), gpios)

static struct gpio_callback 	button_cb_data;
static event_loop_t 			event_loop;
static state_t 					state;

// Power button debounce variables (TODO: Add to gpio_callback or higher struct)
#define DEBOUNCE_CNT			5
#define DEBOUNCE_TIMER_PERIOD	K_MSEC(1)
static bool 					debounce = false;
static uint32_t 				debounce_cnt = DEBOUNCE_CNT;
static struct k_timer 			debounce_timer;

static void gpio_init();
static void button_event_handler(const struct device *dev, struct gpio_callback *cb, uint32_t pins);
static void debounce_timer_handler(struct k_timer *timer_id);
static void button_press_handler();

void main(void)
{
	LOG_INF("Starting main app thread ...");

	int32_t ret = 0;

	ret = event_loop_init(&event_loop);
	if(ret != 0) {
		LOG_ERR("Failed to initialize event loop");
		return;
	}

	gpio_init();
	state_init(&state);
		
	// Create a timer for the debounce code
	k_timer_init(&debounce_timer, debounce_timer_handler, NULL);
	
	event_t *event = NULL;
	while(1) 
	{
		event = event_loop_get_event(&event_loop);

		if(event != NULL) {
			ret = state_update(&state, event);
			if(ret) {
				LOG_ERR("Woops, something not right with state machine, exiting...");
				break;
			}

			event_loop_free_event(&event_loop, event);
		}
	}

	while (1) {
		k_msleep(SLEEP_TIME_MS);
	}
}

void gpio_init()
{
	int32_t ret;
	const struct device *dev_led = NULL;

	// Setup BTN PIN. For some reason Zephyr gpio driver functions do not setup
	// GPIO interrupt in a way, that system can be woken up from the POWER_OFF state.
	// So use NRF GPIO Hal functions
	// [TODO] Need to test it, but possible that I just need to use it for IRQ setup 
	nrf_gpio_cfg_input(DT_GPIO_PIN(DT_NODELABEL(button1), gpios),
					NRF_GPIO_PIN_PULLUP);

	const struct device *dev_btn = device_get_binding(DT_GPIO_LABEL(DT_ALIAS(sw1), gpios));
	if(dev_btn == NULL) {
		LOG_ERR("BTN device is NULL");
		return;
	}

	gpio_init_callback(&button_cb_data, button_event_handler, BIT(BUTTON_GPIO_PIN));
	gpio_add_callback(dev_btn, &button_cb_data);


	// Setup STATE LED
	dev_led = device_get_binding(DT_GPIO_LABEL(DT_ALIAS(led0), gpios));
	if(dev_led == NULL) {
		LOG_ERR("LED0 device is NULL");
		return;
	}

	ret = gpio_pin_configure(dev_led, DT_GPIO_PIN(DT_ALIAS(led0), gpios), GPIO_OUTPUT_INACTIVE | DT_GPIO_FLAGS(DT_ALIAS(led0), gpios));
	if (ret < 0) {
		LOG_ERR("Failed to initialize 'Status LED' [%u]", ret);
		return;
	}
}

void button_event_handler(const struct device *dev, struct gpio_callback *cb, uint32_t pins)
{
	debounce = true;
	debounce_cnt = DEBOUNCE_CNT;

	k_timer_start(&debounce_timer, DEBOUNCE_TIMER_PERIOD, DEBOUNCE_TIMER_PERIOD);
}

void debounce_timer_handler(struct k_timer *timer_id)
{
	if(debounce == true) {
		debounce_cnt--;
		if(debounce_cnt == 0) {
			debounce = false;
			debounce_cnt = DEBOUNCE_CNT;
			k_timer_stop(&debounce_timer);

			button_press_handler();
		}
	}
}

void button_press_handler()
{
	key_event_t *event = (key_event_t *)event_loop_alloc_event(&event_loop, EVENT_KEY);
	if(event == NULL) {
		LOG_ERR("Failed to allocate memory for the key event");
		return;
	}

	event->key_state = gpio_pin_get(state.dev_btn, BUTTON_GPIO_PIN);

	event_loop_put(&event_loop, (event_t *)event);
}
```

## src/bt_service.c
```c
#include "bt_service.h"

#include <logging/log.h>

#include <bluetooth/bluetooth.h>
#include <bluetooth/hci.h>
#include <bluetooth/uuid.h>
#include <bluetooth/conn.h>
#include <bluetooth/gatt.h>

#define NUM_GPIOS 5

LOG_MODULE_REGISTER(bt_service);

// Prototypes

static void        bt_ready(int err);
static void        connected(struct bt_conn *connected, uint8_t err);
static void        disconnected(struct bt_conn *disconn, uint8_t reason);
static ssize_t     write_feature_0(struct bt_conn *conn, const struct bt_gatt_attr *attr, const void *buf, uint16_t len, uint16_t offset, uint8_t flags);
static ssize_t     write_feature_1(struct bt_conn *conn, const struct bt_gatt_attr *attr, const void *buf, uint16_t len, uint16_t offset, uint8_t flags);
static ssize_t     write_feature_2(struct bt_conn *conn, const struct bt_gatt_attr *attr, const void *buf, uint16_t len, uint16_t offset, uint8_t flags);
static ssize_t     write_feature_3(struct bt_conn *conn, const struct bt_gatt_attr *attr, const void *buf, uint16_t len, uint16_t offset, uint8_t flags);
static ssize_t     write_feature_4(struct bt_conn *conn, const struct bt_gatt_attr *attr, const void *buf, uint16_t len, uint16_t offset, uint8_t flags);
static ssize_t     write_feature(uint8_t idx, const void *buf, uint16_t len, uint16_t offset);
static void        ccc_cfg_changed(const struct bt_gatt_attr *attr, uint16_t value);

static void        set_gpio(uint8_t idx, uint16_t value);

// Static structures

static struct bt_conn *conn = NULL;

static struct bt_conn_cb conn_callbacks = {
    .connected = connected,
    .disconnected = disconnected,
};

#define MANUF_DATA_LEN 7
static uint8_t manuf_data[MANUF_DATA_LEN] = {
    0xFF, 0xFF,         // Manufacturer ID 
    0xDE,               // Feature #1
    0xAD,               // Feature #2
    0xBE,               // Feature #3
    0xEF,               // Feature #4
    0x00                // Feature #5
};

static const struct bt_data addvertisement_data[] = {
    { 
        .type = BT_DATA_FLAGS,
        .data_len = 1,
        .data = (uint8_t []) { (BT_LE_AD_GENERAL | BT_LE_AD_NO_BREDR) },
    },
    { 
        .type = BT_DATA_MANUFACTURER_DATA,
        .data_len = MANUF_DATA_LEN,
        .data = (const uint8_t *)(manuf_data),
    }
};

static struct bt_uuid_128 service_uuid = 
    BT_UUID_INIT_128(   0x5c, 0xf2, 0xab, 0x1a, 0x8b, 0x77, 0x45, 0x3e, 
                        0x9b, 0x21, 0x57, 0x51, 0x2e, 0x81, 0x00, 0xda);

static struct bt_uuid_128 feature_char_uuids[] =  {
    BT_UUID_INIT_128(   0xe1, 0x5b, 0xf6, 0x0d, 0x89, 0x44, 0x47, 0x5f,
                        0xaa, 0x56, 0x84, 0xf7, 0x97, 0x95, 0xd8, 0x98),
    BT_UUID_INIT_128(   0x5e, 0xe6, 0x02, 0x02, 0x12, 0x5d, 0x48, 0xf5,
                        0xaa, 0x98, 0xd7, 0x48, 0xa2, 0x52, 0x4b, 0x6c),
    BT_UUID_INIT_128(   0xb5, 0x21, 0x4d, 0x3f, 0xd6, 0xf6, 0x47, 0x51,
                        0xbc, 0x9f, 0x22, 0x9e, 0xbc, 0x63, 0xdf, 0x81),
    BT_UUID_INIT_128(   0xa7, 0x7c, 0x33, 0xb3, 0x05, 0x80, 0x46, 0x7a,
                        0xa3, 0x84, 0x8f, 0xd6, 0x83, 0x05, 0x05, 0x07),
    BT_UUID_INIT_128(   0xc0, 0x64, 0xe2, 0xb7, 0x2b, 0xfb, 0x4d, 0x45,
                        0xbb, 0x4e, 0x9b, 0x9e, 0x06, 0x5b, 0xea, 0x0a)
};

BT_GATT_SERVICE_DEFINE(gpio_svc,
    BT_GATT_PRIMARY_SERVICE(&service_uuid),
    BT_GATT_CHARACTERISTIC(&feature_char_uuids[0].uuid,
            BT_GATT_CHRC_READ | BT_GATT_CHRC_WRITE_WITHOUT_RESP,
            BT_GATT_PERM_WRITE, NULL, write_feature_0, (void *)1),
    BT_GATT_CHARACTERISTIC(&feature_char_uuids[1].uuid,
            BT_GATT_CHRC_READ | BT_GATT_CHRC_WRITE_WITHOUT_RESP,
            BT_GATT_PERM_WRITE, NULL, write_feature_1, (void *)1),
    BT_GATT_CHARACTERISTIC(&feature_char_uuids[2].uuid,
            BT_GATT_CHRC_READ | BT_GATT_CHRC_WRITE_WITHOUT_RESP,
            BT_GATT_PERM_WRITE, NULL, write_feature_2, (void *)1),
    BT_GATT_CHARACTERISTIC(&feature_char_uuids[3].uuid,
            BT_GATT_CHRC_READ | BT_GATT_CHRC_WRITE_WITHOUT_RESP,
            BT_GATT_PERM_WRITE, NULL, write_feature_3, (void *)1),
    BT_GATT_CHARACTERISTIC(&feature_char_uuids[4].uuid,
            BT_GATT_CHRC_READ | BT_GATT_CHRC_WRITE_WITHOUT_RESP,
            BT_GATT_PERM_WRITE, NULL, write_feature_4, (void *)1),
    BT_GATT_CCC(ccc_cfg_changed, BT_GATT_PERM_READ | BT_GATT_PERM_WRITE),
);


int32_t bt_service_start()
{
    int32_t ret;

    LOG_INF("Initialize Bluetooth");

    bt_conn_cb_register(&conn_callbacks);

    ret = bt_enable(bt_ready);
    if(ret) {
        LOG_ERR("Bluetooth init failed (err %d)", ret);
    }

    return ret;
}

// int32_t bt_service_stop()
// {

// }

static void bt_ready(int err)
{
    LOG_INF("Bluetooth ready");

    char addr_s[BT_ADDR_LE_STR_LEN];

    bt_addr_le_t addr = {0};
    size_t count = 1;

    if(err) {
        LOG_ERR("Bluetooth init failed (err %d)", err);
        return;
    }

    err = bt_le_adv_start(  BT_LE_ADV_CONN_NAME,
                            addvertisement_data,    ARRAY_SIZE(addvertisement_data),
                            NULL,                   0);

    if (err) {
        LOG_ERR("Advertising failed to start (err %d)\n", err);
        return;
    }

    bt_id_get(&addr, &count);
    bt_addr_le_to_str(&addr, addr_s, sizeof(addr_s));

    LOG_INF("Beacon started, advertising as %s\n", addr_s);
}

void connected(struct bt_conn *connected, uint8_t err)
{
    if (err) {
        LOG_ERR("Client connection failed (err %u)", err);
    } else {
        LOG_INF("Connected");
        if (!conn) {
            conn = bt_conn_ref(connected);
        }
    }
}

void disconnected(struct bt_conn *disconn, uint8_t reason)
{
    if (conn) {
        bt_conn_unref(conn);
        conn = NULL;
    }

    LOG_INF("Disconnected (reason %u)", reason);
}

ssize_t write_feature_0(   struct bt_conn *conn,
                const struct bt_gatt_attr *attr, const void *buf,
                uint16_t len, uint16_t offset, uint8_t flags)
{
    return write_feature(0, buf, len, offset);
}

ssize_t write_feature_1(   struct bt_conn *conn,
                const struct bt_gatt_attr *attr, const void *buf,
                uint16_t len, uint16_t offset, uint8_t flags)
{
    return write_feature(1, buf, len, offset);
}

ssize_t write_feature_2(   struct bt_conn *conn,
                const struct bt_gatt_attr *attr, const void *buf,
                uint16_t len, uint16_t offset, uint8_t flags)
{
    return write_feature(2, buf, len, offset);
}

ssize_t write_feature_3(   struct bt_conn *conn,
                const struct bt_gatt_attr *attr, const void *buf,
                uint16_t len, uint16_t offset, uint8_t flags)
{
    return write_feature(3, buf, len, offset);
}

ssize_t write_feature_4(   struct bt_conn *conn,
                const struct bt_gatt_attr *attr, const void *buf,
                uint16_t len, uint16_t offset, uint8_t flags)
{
    return write_feature(4, buf, len, offset);
}

ssize_t write_feature(uint8_t idx, const void *buf, uint16_t len, uint16_t offset)
{
    uint16_t value = 0; 

    if (offset + len > sizeof(value)) {
        LOG_ERR("Invalid offset received");
        return BT_GATT_ERR(BT_ATT_ERR_INVALID_OFFSET);
    }

    memcpy(&value, buf, len);

    set_gpio(idx, value);

    return 0;
}

void set_gpio(uint8_t idx, uint16_t value)
{
    LOG_INF("Set gpio:%u, value:%u", (uint32_t)idx, (uint32_t)value);

    if(idx >= NUM_GPIOS) {
        LOG_ERR("Invalid GPIO idx");
    }
}

void ccc_cfg_changed(const struct bt_gatt_attr *attr, uint16_t value)
{
    ARG_UNUSED(attr);
    LOG_INF("Notification state changed:%u", (uint32_t)value);
}
```

## src/bt_service.h
```c
#ifndef BT_SERVICE_H
#define BT_SERVICE_H

#include <stdint.h>

int32_t bt_service_start();
// int32_t bt_service_stop();

#endif
```

## src/event_loop.c
```c
#include "event_loop.h"


int32_t event_loop_init(event_loop_t *loop)
{
    if(loop == NULL) {
        return -1;
    }

    k_fifo_init(&(loop->_events));

    return 0;
}

event_t* event_loop_get_event(event_loop_t *loop)
{
    return k_fifo_get(&(loop->_events), K_FOREVER);
}

event_t* event_loop_alloc_event(event_loop_t *loop, event_type_t type)
{
    event_t *evt = NULL;

    if(type == EVENT_KEY) {
        evt = (event_t*)k_malloc(sizeof(key_event_t));
        if(evt != NULL) {
            evt->_event_type = type;
        }
    }
    
    return evt;
}

void event_loop_put(event_loop_t *loop, event_t *event)
{
    k_fifo_put(&(loop->_events), event);
}

void event_loop_free_event(event_loop_t *loop, event_t *event)
{
    (void)loop;
    k_free(event);
}
```

## src/event_loop.h
```c
#ifndef EVENT_LOOP_H
#define EVENT_LOOP_H

#include <zephyr.h>

typedef struct 
{
    struct k_fifo _events;
} 
event_loop_t;

typedef enum 
{
    EVENT_NONE = 0,
    EVENT_KEY
} 
event_type_t;

typedef struct 
{
    void *          _fifo_reserved;
    event_type_t    _event_type;
}
event_t;

typedef struct
{
    event_t         _event;
    uint32_t        key_state;
} 
key_event_t;



int32_t     event_loop_init(event_loop_t *loop);
event_t*    event_loop_get_event(event_loop_t *loop);
event_t*    event_loop_alloc_event(event_loop_t *loop, event_type_t type);
void        event_loop_put(event_loop_t *loop, event_t *event);
void        event_loop_free_event(event_loop_t *loop, event_t *event);


#endif
```

## src/system_state.c
```c
#include "system_state.h"

#include <zephyr.h>
#include <init.h>
#include <devicetree.h>
#include <drivers/gpio.h>
#include <pm/pm.h>
#include <logging/log.h>

#include <string.h>

#include <hal/nrf_gpio.h>

#define BTN_PRESSED                     0
#define BTN_RELEASED                    1
#define SYSTEM_ON_THRESHOLD_MS          2000
#define PAIRING_THRESHOLD_MS            4000

#define BUTTON_GPIO_PIN                 DT_GPIO_PIN(DT_ALIAS(sw1), gpios)

LOG_MODULE_REGISTER(state);


static const struct smf_state system_states[];

enum system_state 
{
    DEEP_SLEEP = 0,
    RESET,
    ADVERTISE,
    PAIRING,
    CONNECTED
};

// ------------------------------------------------------
//   DEEP_SLEEP state
// ------------------------------------------------------
static void deep_sleep_entry(void *o)
{
    LOG_INF("%s", __func__);

    state_t *state = (state_t *)o;
    if((state->dev_btn == NULL) || (state->dev_led == NULL)){
        LOG_WRN("Woops, something not right:%s", __func__);
        return;
    }

    // Turn status LED OFF
    gpio_pin_set(state->dev_led, DT_GPIO_PIN(DT_ALIAS(led0), gpios), 0);

    // Setup GPIO IRQ, so that system can wake up on BTN interrupt
    nrf_gpio_cfg_sense_set(DT_GPIO_PIN(DT_NODELABEL(button1), gpios),NRF_GPIO_PIN_SENSE_LOW);

    // Force DEEP SLEEP mode
    pm_power_state_force(0u, (struct pm_state_info){PM_STATE_SOFT_OFF, 0, 0});
}

static void deep_sleep_run(void *o)
{
    LOG_INF("%s: Should go to sleep after this", __func__);
}

static void deep_sleep_exit(void *o)
{
    LOG_WRN("%s: Deep sleep state: How did we get here?", __func__);
}


// ------------------------------------------------------
//   RESET state
// ------------------------------------------------------
static void reset_entry(void *o)
{
    LOG_INF("%s", __func__);

    state_t *state = (state_t *)o;
    if((state->dev_btn == NULL) || (state->dev_led == NULL)){
        LOG_WRN("Woops, something not right:%s", __func__);
        return;
    }

    // Turn status LED OFF
    gpio_pin_set(state->dev_led, DT_GPIO_PIN(DT_ALIAS(led0), gpios), 0);

    // Check if btn is still down, might be some glich or something or
    // power could be just connected.
    int32_t btn_state = gpio_pin_get(state->dev_btn, BUTTON_GPIO_PIN);
    if(btn_state != BTN_PRESSED) {
        LOG_INF("%s: Button is not pressed, going into DEEP SLEEP", __func__);
        smf_set_state(SMF_CTX(state), &system_states[DEEP_SLEEP]);
    }

    state->pending_pairing = 0;
}

static void reset_run(void *o)
{
    LOG_INF("%s called", __func__);

    enum system_state next_state = RESET;

    state_t *state = (state_t *)o;
    event_t *evt = state->evt;
    
    if((state->dev_btn == NULL) || (state->dev_led == NULL)){
        LOG_WRN("Woops, something not right:%s", __func__);
        return;
    }

    if(evt->_event_type == EVENT_KEY) {
        key_event_t *key_event = (key_event_t *)evt;

        LOG_INF("Handle key event. Key state:%u", key_event->key_state);

        if(key_event->key_state == BTN_RELEASED) {
            uint32_t up_time = k_uptime_get_32();

            LOG_INF("Kernel uptime:%u", up_time);

            if(up_time >= SYSTEM_ON_THRESHOLD_MS) {
                LOG_INF("Reached system ON threshold");
                next_state = ADVERTISE;
            }
            else {
                next_state = DEEP_SLEEP;
            }

            if(up_time >= PAIRING_THRESHOLD_MS) {
                state->pending_pairing = 1;
            }
        }
    }

    if(next_state != RESET) {
        smf_set_state(SMF_CTX(state), &system_states[next_state]);
    }

    LOG_INF("%s completed", __func__);
}

static void reset_exit(void *o)
{
    LOG_INF("%s", __func__);
}

// ------------------------------------------------------
//   ADEVERISE state
// ------------------------------------------------------
static void advertise_entry(void *o)
{
    LOG_INF("%s", __func__);

    state_t *state = (state_t *)o;
    if((state->dev_btn == NULL) || (state->dev_led == NULL)){
        LOG_WRN("Woops, something not right:%s", __func__);
        return;
    }

    // Turn status LED ON
    gpio_pin_set(state->dev_led, DT_GPIO_PIN(DT_ALIAS(led0), gpios), 1);

    LOG_INF("Pending pairing:%u", state->pending_pairing);
}

static void advertise_run(void *o)
{
    LOG_INF("%s", __func__);

    state_t *state = (state_t *)o;
    if((state->dev_btn == NULL) || (state->dev_led == NULL)){
        LOG_WRN("Woops, something not right:%s", __func__);
        return;
    }

    // int32_t btn_state = gpio_pin_get(state->dev_btn, DT_GPIO_PIN(DT_ALIAS(sw1), gpios));

    // if(btn_state == BTN_PRESSED) {
    //     state->btn_down_ticks++;
    // }
    // else {
    //     state->btn_down_ticks = 0;
    // }

    // if(state->btn_down_ticks >= BTN_TICKS_THRESHOLD_SYSTEM_OFF) {
    //     LOG_INF("%s: Reached SYSTEM_OFF threshold", __func__);
    //     smf_set_state(SMF_CTX(state), &system_states[DEEP_SLEEP]);
    // }
}

static void advertise_exit(void *o)
{
    LOG_INF("%s", __func__);
}

static const struct smf_state system_states[] = 
{
    [DEEP_SLEEP]    = SMF_CREATE_STATE(deep_sleep_entry, deep_sleep_run, deep_sleep_exit),
    [RESET]         = SMF_CREATE_STATE(reset_entry, reset_run, reset_exit),
    [ADVERTISE]     = SMF_CREATE_STATE(advertise_entry, advertise_run, advertise_exit)
};

int32_t state_init(state_t *state)
{
    int32_t ret = 0;

    state->dev_led = device_get_binding(DT_GPIO_LABEL(DT_ALIAS(led0), gpios));
    if(state->dev_led == NULL) {
        LOG_ERR("LED0 device is NULL");
        return -1;
    }

    state->dev_btn = device_get_binding(DT_GPIO_LABEL(DT_ALIAS(sw1), gpios));
    if(state->dev_btn == NULL) {
        LOG_ERR("BTN device is NULL");
        return -1;
    }

    ret = gpio_pin_interrupt_configure(state->dev_btn, BUTTON_GPIO_PIN, GPIO_INT_EDGE_BOTH);
    if(ret != 0) {
        LOG_ERR("%s: Failed to initialize button IRQ", __func__);
        return -1;
    }

    smf_set_initial(SMF_CTX(state), &system_states[RESET]);

    return 0;
}

int32_t state_update(state_t *state, event_t *evt)
{
    state->evt = evt;

    return smf_run_state(SMF_CTX(state));
}
```

## src/system_state.h
```c
#ifndef SYSTEM_STATE_H
#define SYSTEM_STATE_H

#include <device.h>
#include <smf.h>

#include "event_loop.h"

typedef struct 
{
    struct          smf_ctx ctx;
    const struct    device *dev_led;
    const struct    device *dev_btn;

    uint32_t        pending_pairing;

    event_t *       evt;                    // This is workarounf for the SMF. SMF do not 
                                            // allow to attach user data when calling update function
} 
state_t;

int32_t state_init(state_t *state);
int32_t state_update(state_t *state, event_t *evt);

#endif
```
